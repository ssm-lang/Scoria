## CMakeLists.txt
```
# SPDX-License-Identifier: Apache-2.0

cmake_minimum_required(VERSION 3.13.1)
find_package(Zephyr REQUIRED HINTS $ENV{ZEPHYR_BASE})
project(blinky-ssm-test)

set(LLBC ../../Sense-VM/backend/src/ll)
set(LLBC_Z ../../Sense-VM/backend/src/ll/os/zephyr)

set(LLBH ../../Sense-VM/backend/include)
set(LLBH_Z ../../Sense-VM/backend/include/ll/os/zephyr)

set(SSM ../runtime)
set(SSMRTS ../runtime/include)
set(SSMPLATFORM ../runtime/linux/include)

file(GLOB app_sources src/*.c)
file(GLOB extra_sources
  ${LLBC}/ll_driver.c
  ${LLBC}/ll_led.c
  ${LLBC}/ll_button.c
  ${LLBC}/os/zephyr/led.c
  ${LLBC}/os/zephyr/button.c
  ${SSM}/src/peng-scheduler.c)

target_sources(app PRIVATE ${app_sources} ${extra_sources})
target_include_directories(app PRIVATE
  ${LLBH}
  ${LLBH_Z}
  ${ZEPHYR_BASE}/kernel/include
  ${ZEPHYR_BASE}/arch/${ARCH}/include
  ${SSMRTS}
  ${SSMPLATFORM}
  include/
  )
```

## prj.conf
```kconfig
CONFIG_GPIO=y
CONFIG_MINIMAL_LIBC_MALLOC_ARENA_SIZE=16384

CONFIG_COUNTER=y
CONFIG_COUNTER_TIMER4=y
```

## src/main.c
```c
/*
 * Copyright (c) 2016 Intel Corporation
 *
 * SPDX-License-Identifier: Apache-2.0
 */

#include <zephyr.h>
#include <drivers/counter.h>
#include <zephyr/types.h>
#include <stddef.h>

#include <ll/ll_driver.h>
#include <ll/ll_led.h>
#include <ll/ll_button.h>
#include <hal/zephyr/svm_zephyr.h>

#include <stdbool.h>
#include <stdio.h>

#include <peng.h>

extern peng_time_t now;

typedef struct {
  uint8_t driverid;
  uint8_t buttonevent;
} button_msg;

struct tick_message {
  uint8_t type; // 0 for nothing, 1 for button
  union {
    bool nothing;
    button_msg button_data;
  } data;
};

#define MAX_MESSAGES  100
#define MSG_ALIGNMENT 1

K_MSGQ_DEFINE(tick_msgq, sizeof(struct tick_message), MAX_MESSAGES,MSG_ALIGNMENT);

/********** This code will be generated when button IO is required **********/

/*
 * Button variable
 */
typedef struct {
  /* Generic SV fields */
  void (*update)(sv_t *);
  struct trigger *triggers;
  peng_time_t last_updated;
  peng_time_t event_time;
  void (*to_string)(sv_t *, char *, size_t);

  /* Button specific fields */
  ll_driver_t driver;
  bool value;
  bool event_value;
} sv_button_t;

sv_button_t buttons[4];

void to_string_button(sv_t *v, char *buffer, size_t size);
void initialize_button(sv_button_t *v, uint32_t driverid, uint32_t buttonid); // NOTE: Extra fields here
void assign_button(sv_button_t *v,  priority_t priority, bool value);
void later_button(sv_button_t *v, peng_time_t time, bool value);
void update_button(sv_t *var);

char buttons_buffer[10*sizeof(ll_driver_msg_t)];
struct k_msgq button_queue;

extern int send_message(zephyr_interop_t* this, ll_driver_msg_t msg);
zephyr_interop_t button_interop = { .msgq         = &button_queue
                                  , .send_message = send_message
                                  };

void init_button_interop() {
  k_msgq_init(&button_queue, buttons_buffer, sizeof(ll_driver_msg_t), 10);
}

void to_string_button(sv_t *v, char *buffer, size_t size) {
    sv_button_t* iv = (sv_button_t *) v;
    char str[] = "button %s";
    snprintf(buffer, size, str, iv->value ? "button-down" : "button-up");
}

void initialize_button(sv_button_t *v, uint32_t driverid, uint32_t buttonid) {
  assert(v);
  /* Generic initialization */
  *v = (sv_button_t) { .to_string = to_string_button,
                    .update       = update_button,
                    .triggers     = NULL,
			              .last_updated = now,
			              .event_time   = NO_EVENT_SCHEDULED };

  /* Button specific initialization */
  if(ll_button_init(&v->driver, driverid, &button_interop, buttonid)) {
      printk("Button-driver %d successfully initialized\n", buttonid);
  } else {
      printk("driver failed to initialize\n");
  }
}

void assign_button(sv_button_t *v,  priority_t priority, bool value) {
  v->value = value;
  v->last_updated = now;
  schedule_sensitive((sv_t *) v, priority);
}

void later_button(sv_button_t *v, peng_time_t time, bool value) {
  assert(v);
  v->event_value = value;
  later_event((sv_t *) v, time);
}

void update_button(sv_t *var)
{
  assert(var);
  assert(var->event_time == now);
  sv_button_t *v = (sv_button_t *) var;
  v->value = v->event_value;
}

void button_thread_loop() {
  ll_driver_msg_t btn_msg;
  struct tick_message tick_msg;
  while(1) {
    k_msgq_get(&button_queue, &btn_msg, K_FOREVER);
    tick_msg.type = 1;
    button_msg button_data = { .driverid = btn_msg.driver_id
                             , .buttonevent = btn_msg.data
                             };
    tick_msg.data.button_data = button_data;
    k_msgq_put(&tick_msgq, &tick_msg, K_NO_WAIT);
  }
}

/********** End of button code **********/

/********** This code will be generated when LED IO is required **********/

/*
 * LED variable
 */
typedef struct {
  /* Generic SV fields */
  void (*update)(sv_t *);
  struct trigger *triggers;
  peng_time_t last_updated;
  peng_time_t event_time;
  void (*to_string)(sv_t *, char *, size_t);

  /* LED specific fields */
  ll_driver_t driver;
  bool value;
  bool event_value;
} sv_led_t;

void to_string_led(sv_t *v, char *buffer, size_t size);
void initialize_led(sv_led_t *v, uint32_t ledid); // NOTE: Extra field here
void assign_led(sv_led_t *v,  priority_t priority, bool value);
void later_led(sv_led_t *v, peng_time_t time, bool value);
void update_led(sv_t *var);

void to_string_led(sv_t *v, char *buffer, size_t size) {
    sv_led_t* iv = (sv_led_t *) v;
    char str[] = "led %s";
    snprintf(buffer, size, str, iv->value ? "on" : "off");
}

void initialize_led(sv_led_t *v, uint32_t ledid) {
  assert(v);
  /* Generic initialization */
  *v = (sv_led_t) { .to_string    = to_string_led,
                    .update       = update_led,
                    .triggers     = NULL,
			        .last_updated = now,
			        .event_time   = NO_EVENT_SCHEDULED };

  /* LED specific initialization */
  if(ll_led_init(&v->driver, ledid, 0)) {
      printk("LED-driver %d successfully initialized\n", ledid);
  } else {
      printk("driver failed to initialize\n");
  }
}

void assign_led(sv_led_t *v,  priority_t priority, bool value) {
  v->value = value;
  v->last_updated = now;
  schedule_sensitive((sv_t *) v, priority);

  /* After performing the assignment, reflect the new value in the driver */
  uint8_t cmd = v->value ? 1 : 0;
  ll_write(&v->driver, &cmd, 1);
}

void later_led(sv_led_t *v, peng_time_t time, bool value) {
  assert(v);
  v->event_value = value;
  later_event((sv_t *) v, time);
}

void update_led(sv_t *var)
{
  assert(var);
  assert(var->event_time == now);
  sv_led_t *v = (sv_led_t *) var;
  v->value = v->event_value;

  /* After updating the value, reflect the new value in the driver */
  uint8_t cmd = v->value ? 1 : 0;
  ll_write(&v->driver, &cmd, 1);
}

/********** End of LED IO file **********/

/********** SSM program **********/

typedef struct {
  stepf_t *step;
  struct act *caller;
  uint16_t pc;
  uint16_t children;
  priority_t priority;
  depth_t depth;
  bool scheduled;
  trigger_t trig1;
} act_flipled_t;

act_flipled_t *enter_flipled(act_t *caller, priority_t priority, depth_t depth);
void step_flipled(act_t *gen_act);

act_flipled_t *enter_flipled(act_t *caller, priority_t priority, depth_t depth)
{
    act_t *gen_act = enter(sizeof(act_flipled_t), step_flipled, caller, priority, depth);
    act_flipled_t *act = (act_flipled_t *) gen_act;
    act->trig1.act = (act_t *) act;
    return act;
}

extern sv_led_t led0;
extern sv_button_t *button0;

/* The idea is that when this procedure was written in the EDSL, the programmer
 * would get access to the LED by calling e.g `getLed 0`. When this call is made all
 * the above crap is scheduled for generation during compilation, and this procedure
 * gets access to the LED through the variable above.
 */
void step_flipled(act_t *gen_act)
{
    act_flipled_t *act = (act_flipled_t *) gen_act;
    
    switch(act->pc) {
        case 0:
            // while
            L0:
            printf("ACT: enter while\n");
            if (!(true)) goto L1;
//            later_led(&led0, now + 8000000UL, true);
            // if this was e.g a button, only enable the button
            // callback when someone waits for the button.
            // Disable it when no one is waiting for it.
            printf("ACT: going to wait for button0\n");
            sensitize((sv_t *)button0, &act->trig1);
            act->pc = 1;
            return;
        case 1:
            desensitize(&act->trig1);
            printf("ACT: woke up, button0 was pressed\n");
            printf("ACT: scheduling event on led0\n");
            later_led(&led0, now + 16000000UL, true);
            printf("ACT: waiting for button0\n");
            sensitize((sv_t *)&led0, &act->trig1);
            act->pc = 2;
            return;
        case 2:
            desensitize(&act->trig1);
            later_led(&led0, now + 16000000UL, false);
//            sensitize((sv_t *)&led0, &act->trig1);
            printf("ACT: wake up, button0 was pressed\n");
            printf("ACT: scheduling event on led0\n");
//            later_led(&led0, now + 16000000UL, false);
            
            goto L0;
            L1:
        case 3:
        leave((act_t *) act, sizeof(act_flipled_t));
    }
}

/********** End of SSM program **********/













































/* Below follows lots of Joel-magic I don't quite understand~ */

//#define PRINT usb_printf
#define PRINT printk

/* ********** */
/*   TIMER    */

#define TIMER DT_LABEL(DT_ALIAS(ssm_timer))
/* Not sure how to do the similar thing on the STM32 yet. */

struct  counter_alarm_cfg alarm_cfg;

const struct device *counter_dev = NULL;

/* *************** */
/*   TOP           */

void top_return(act_t *act)
{
  return;
}

act_t top = { .step = top_return };

/* ************************************************************ */
/* hw_tick                                                      */
/* ************************************************************ */

void hw_tick(const struct device *dev, uint8_t chan, uint32_t ticks, void *user_data) {

  /* Put a tick on the messagebox */
  struct tick_message msg = { .type         = 0
                            , .data.nothing = 0
                            };
//  uint8_t msg = 1;
  k_msgq_put(&tick_msgq, &msg, K_NO_WAIT);
  /* this can fail to send the message. then what? */
}

K_THREAD_STACK_DEFINE(tick_thread_stack, 512);
struct k_thread tick_thread;

/* NOTE: Here we define the LED */
sv_led_t led0;
sv_button_t *button0;

void tick_thread_main(void * a, void* b, void *c) {
  (void)a;
  (void)b;
  (void)c;

  /* NOTE: Here the LEDs is initialized*/
  initialize_led(&led0, 0);
  led0.value = false;

  /* NOTE: Here the Buttons are initialized*/
  init_button_interop();
  button0 = &buttons[0];
  initialize_button(button0, 0, 0);
  button0->value = false;

  now = 0;

  struct tick_message recv_msg;

  fork_routine( (act_t *) enter_flipled(&top, PRIORITY_AT_ROOT, DEPTH_AT_ROOT) );

  int i = 0;
  while (1) {

    /* get a data item, waiting as long as needed */
    k_msgq_get(&tick_msgq, &recv_msg, K_FOREVER);
    if(recv_msg.type == 1 && recv_msg.data.button_data.buttonevent == 1) {
      uint32_t count;
      counter_get_value(counter_dev, &count);
      now = count;

      button_msg bd = recv_msg.data.button_data;
      printk("button_press! driverid: %u, buttonstatus: %u\n", bd.driverid, bd.buttonevent);
      printk("scheduling update...\n");
      sv_button_t* button = &buttons[bd.driverid];
      later_button(button, now + 1, bd.buttonevent);
//      assign_button(button, 0, bd.buttonevent); // 0 because we want to wake up everyone
      continue;
    }

    now = next_event_time();
    tick();

    peng_time_t next = next_event_time();

    if (next == ULLONG_MAX) {
      /* This just means that there are no events in the queue (or a remarkable coincidence) */
      /* What to do in this case ?*/
      /*  - Go to sleep and await being woken from outside source */

      PRINT("NOTHING IN THE QUEUE\r\n");
      continue;
    }

    uint64_t wake_time = next_event_time(); /* Absolute time */

    //PRINT("sleep_time = %lld\r\n", sleep_time);

    alarm_cfg.flags = COUNTER_ALARM_CFG_ABSOLUTE | COUNTER_ALARM_CFG_EXPIRE_WHEN_LATE;
    alarm_cfg.ticks = wake_time;

    int r = counter_set_channel_alarm(counter_dev, 0, &alarm_cfg);
    if (!r) {
      //PRINT("hw_tick: Alarm set\r\n");
    } else {
      if (r == - ENOTSUP ) {
	PRINT("hw_tick: Error setting alarm (ENOTSUP)\r\n");
      } else if ( r == - EINVAL ) {
	PRINT("hw_tick: Error setting alarm (EINVAL)\r\n");
      } else if ( r == - ETIME ) {
	PRINT("hw_tick: Error setting alarm (ETIME)\r\n");
  printk("wake time = %llu\n", wake_time);
      } else {
	PRINT("hw_tick: Error setting alarm\r\n");
      }
    }

    i++;
  }
}

K_THREAD_STACK_DEFINE(button_thread_stack, 512);
struct k_thread button_thread;

void start_tick_thread(void) {

  k_thread_create(&tick_thread, tick_thread_stack,
		  K_THREAD_STACK_SIZEOF(tick_thread_stack),
		  tick_thread_main,
		  NULL, NULL, NULL,
		  5, 0, K_NO_WAIT);
  
  k_thread_create(&button_thread, button_thread_stack,
      K_THREAD_STACK_SIZEOF(tick_thread_stack),
      button_thread_loop,
      NULL, NULL, NULL,
      5, 0, K_NO_WAIT);
}

/* ************************************************************ */
/* MAIN                                                         */
/* ************************************************************ */


void main(void) {

  PRINT("Sleeping 1 seconds\r\n");
  k_sleep(K_SECONDS(1)); // Wait enough for starting up a terminal.
  PRINT("WOKE UP\r\n");

  /* ************************* */
  /* Hardware timer experiment */
  counter_dev = device_get_binding(TIMER);
  if (!counter_dev) {
    PRINT("HWCounter: Device not found error\r\n");
  }

  if (counter_get_frequency(counter_dev) > 1000000) {
    PRINT("HWCounter: Running at %dMHz\r\n", counter_get_frequency(counter_dev) / 1000000);
  } else {
    PRINT("HWCounter: Running at %dHz\r\n", counter_get_frequency(counter_dev));
  } // Här kanske jag kan räkna ut hur många ticks som är en ms

  alarm_cfg.flags = COUNTER_ALARM_CFG_ABSOLUTE | COUNTER_ALARM_CFG_EXPIRE_WHEN_LATE;
  alarm_cfg.ticks = 10; //counter_us_to_ticks(counter_dev, 0);
  alarm_cfg.callback = hw_tick;
  alarm_cfg.user_data = &alarm_cfg;


  if (!counter_set_channel_alarm(counter_dev, 0, &alarm_cfg)) {
    PRINT("HWCounter: Alarm set\r\n");
  } else {
    PRINT("HWCounter: Error setting alarm\r\n");
  }
  if (!counter_set_guard_period(counter_dev, UINT_MAX/2, COUNTER_GUARD_PERIOD_LATE_TO_SET)) {
    PRINT("HWCounter: Guard period set\r\n");
  } else {
    PRINT("HWCounter: Error setting guard period\r\n");
  }

  counter_start(counter_dev);

  /* configure uart */

  PRINT("Starting Tick-Thread\r\n");
  start_tick_thread();
}


 int send_message(zephyr_interop_t* this, ll_driver_msg_t msg) {
   return k_msgq_put(this->msgq,(void*)&msg, K_NO_WAIT);
 }

// void main(void) {
//   char buffer[10 * sizeof(ll_driver_msg_t)];
//   struct k_msgq q;
//   k_msgq_init(&q, buffer, sizeof(ll_driver_msg_t), 10);

//   zephyr_interop_t t;
//   t.msgq         = &q;
//   t.send_message = send_message;

//   ll_driver_t button;
//   ll_button_init(&button, 0, &t, 0);

//   while(1) {
//     ll_driver_msg_t msg;
//     k_msgq_get(&q, &msg, K_FOREVER);
//     printk("felt click, drive value: %u\n", msg.data);
//   }
// }
```

## include/peng-button.h
```c
#ifndef PENG_BUTTON_
#define PENG_BUTTON_

#include <zephyr.h>

#include <stdbool.h>
#include <stdio.h>

#include <peng.h>

#include <ll/ll_driver.h>
#include <ll/ll_button.h>

/********** This code will be generated when button IO is required **********/

/*
 * Button variable
 */
typedef struct {
  /* Generic SV fields */
  void (*update)(sv_t *);
  struct trigger *triggers;
  peng_time_t last_updated;
  peng_time_t event_time;
  void (*to_string)(sv_t *, char *, size_t);

  /* Button specific fields */
  ll_driver_t driver;
  bool value; // again, using a boolean to simulate button states. Want ADT types here.
  bool event_value;
} sv_button_t;

/*
 * The compiler will statically know how many different buttons will be
 * interacted with, and will allocate an array big enough to hold the buttons.
 */
extern sv_button_t buttons[4];

void to_string_button(sv_t *v, char *buffer, size_t size);
void initialize_button(sv_button_t *v, uint32_t driverid, uint32_t buttonid); // NOTE: Extra fields here
void assign_button(sv_button_t *v,  priority_t priority, bool value);
void later_button(sv_button_t *v, peng_time_t time, bool value);
void update_button(sv_t *var);

#endif // PENG_BUTTON
```

## include/peng-led.h
```c
#ifndef PENG_LED_
#define PENG_LED_

#include <zephyr.h>

#include <stdbool.h>
#include <stdio.h>

#include <peng.h>

#include <ll/ll_driver.h>
#include <ll/ll_led.h>

/********** This code will be generated when LED IO is required **********/

/*
 * LED variable
 */
typedef struct {
  /* Generic SV fields */
  void (*update)(sv_t *);
  struct trigger *triggers;
  peng_time_t last_updated;
  peng_time_t event_time;
  void (*to_string)(sv_t *, char *, size_t);

  bool value;
  bool event_value;

  /* LED specific fields */
  ll_driver_t driver; // driver used to toggle leds
  /* For this example we use a bool to model LED state, but we want our
   * own ADT type here later.
   */
} sv_led_t;

void to_string_led(sv_t *v, char *buffer, size_t size);
void initialize_led(sv_led_t *v, uint32_t ledid); // NOTE: Extra field here
void assign_led(sv_led_t *v,  priority_t priority, bool value);
void later_led(sv_led_t *v, peng_time_t time, bool value);
void update_led(sv_t *var);

#endif // PENG_LED
```

## include/peng-program.h
```c
#ifndef PENG_PROGRAM_H_
#define PENG_PROGRAM_H_

#include <peng.h>

typedef struct {
  stepf_t *step;
  struct act *caller;
  uint16_t pc;
  uint16_t children;
  priority_t priority;
  depth_t depth;
  bool scheduled;
  trigger_t trig1;
  trigger_t trig2;
  trigger_t trig3;
  trigger_t trig4;
} act_flipled_t;

act_flipled_t *enter_flipled(act_t *caller, priority_t priority, depth_t depth);
void step_flipled(act_t *gen_act);

#endif
```

## src/peng-button.c
```c
#include <zephyr.h>

#include <stdbool.h>
#include <stdio.h>

#include <peng.h>

#include <ll/ll_driver.h>
#include <ll/ll_button.h>
#include <hal/zephyr/svm_zephyr.h>

#include <peng-button.h>

extern struct k_msgq tick_msgq;

/********** This code will be generated when button IO is required **********/

/* Function used by the ll-driver to deliver button events */
int send_message(zephyr_interop_t* this, ll_driver_msg_t msg) {
   return k_msgq_put(this->msgq,(void*)&msg, K_NO_WAIT);
}

/* This is part of the ll-driver interface Joel & Abi wrote */
extern int send_message(zephyr_interop_t* this, ll_driver_msg_t msg);
zephyr_interop_t button_interop = { .msgq         = &tick_msgq
                                  , .send_message = send_message
                                  };

void to_string_button(sv_t *v, char *buffer, size_t size) {
    sv_button_t* iv = (sv_button_t *) v;
    char str[] = "button %s";
    snprintf(buffer, size, str, iv->value ? "button-down" : "button-up");
}

/*
* Below follow the type specific functions for buttons. They are not really
 * interesting, apart from the initialization function. We don't want anything
 * special to happen when we assign to a button (this should probably not be
 * allowed by the compiler), and events will go via another route (will explain
 * further down).
 */
void initialize_button(sv_button_t *v, uint32_t driverid, uint32_t buttonid) {
  assert(v);
  /* Generic initialization */
  *v = (sv_button_t) { .to_string = to_string_button,
                    .update       = update_button,
                    .triggers     = NULL,
			              .last_updated = now,
			              .event_time   = NO_EVENT_SCHEDULED };

  /* Button specific initialization */
  if(ll_button_init(&v->driver, driverid, &button_interop, buttonid)) {
      printk("Button-driver %d successfully initialized\n", buttonid);
  } else {
      printk("driver failed to initialize\n");
  }
}

void assign_button(sv_button_t *v,  priority_t priority, bool value) {
  v->value = value;
  v->last_updated = now;
  schedule_sensitive((sv_t *) v, priority);
}

void later_button(sv_button_t *v, peng_time_t time, bool value) {
  assert(v);
  v->event_value = value;
  later_event((sv_t *) v, time);
}

void update_button(sv_t *var)
{
  assert(var);
  assert(var->event_time == now);
  sv_button_t *v = (sv_button_t *) var;
  v->value = v->event_value;
}
```

## src/peng-led.c
```c
#include <zephyr.h>

#include <stdbool.h>
#include <stdio.h>

#include <peng.h>

#include <ll/ll_driver.h>
#include <ll/ll_led.h>

#include <peng-led.h>

/********** This code will be generated when LED IO is required **********/

void to_string_led(sv_t *v, char *buffer, size_t size) {
    sv_led_t* iv = (sv_led_t *) v;
    char str[] = "led %s";
    snprintf(buffer, size, str, iv->value ? "on" : "off");
}

void initialize_led(sv_led_t *v, uint32_t ledid) {
  assert(v);
  /* Generic initialization */
  *v = (sv_led_t) { .to_string    = to_string_led,
                    .update       = update_led,
                    .triggers     = NULL,
			        .last_updated = now,
			        .event_time   = NO_EVENT_SCHEDULED };

  /* LED specific initialization */
  if(ll_led_init(&v->driver, ledid, 0)) {
      printk("LED-driver %d successfully initialized\n", ledid);
  } else {
      printk("driver failed to initialize\n");
  }
}

void assign_led(sv_led_t *v,  priority_t priority, bool value) {
  v->value = value;
  v->last_updated = now;
  schedule_sensitive((sv_t *) v, priority);

  /* After performing the assignment, reflect the new value in the driver */
  uint8_t cmd = v->value ? 1 : 0;
  ll_write(&v->driver, &cmd, 1);
}

void later_led(sv_led_t *v, peng_time_t time, bool value) {
  assert(v);
  v->event_value = value;
  later_event((sv_t *) v, time);
}

void update_led(sv_t *var)
{
  assert(var);
  assert(var->event_time == now);
  sv_led_t *v = (sv_led_t *) var;
  v->value = v->event_value;

  /* After updating the value, reflect the new value in the driver */
  uint8_t cmd = v->value ? 1 : 0;
  ll_write(&v->driver, &cmd, 1);
}

/********** End of LED IO file **********/
```

## src/ssm-program.c
```c
#include <stdbool.h>
#include <stdio.h>

#include <peng.h>
#include <peng-led.h>
#include <peng-button.h>
#include <peng-program.h>

act_flipled_t *enter_flipled(act_t *caller, priority_t priority, depth_t depth)
{
    act_t *gen_act = enter(sizeof(act_flipled_t), step_flipled, caller, priority, depth);
    act_flipled_t *act = (act_flipled_t *) gen_act;
    act->trig1.act = (act_t *) act;
    act->trig2.act = (act_t *) act;
    act->trig3.act = (act_t *) act;
    act->trig4.act = (act_t *) act;
    return act;
}

/*
 * When the programmer wrote this procedure in our EDSL he or she used e.g
 * `getLed 0`, `getLed 1` etc, and those calls resulted in (apart from all
 * the fluff above) the below variables to be declared. They will be declared
 * for real and initialized further down, in the main function.
 * 
 * The LED etc does not appear as a parameter to the function, so it might be
 * tricky/might not make sense to model it as such in the generated code. The
 * LED would need to trickle down through the entire callstack, maybe passing
 * by as an argument to a procedure that will not need it. A global variable
 * seems more appropriate.
 */
extern sv_led_t led0;
extern sv_led_t led1;
extern sv_led_t led2;
extern sv_led_t led3;
extern sv_button_t *button0;
extern sv_button_t *button1;
extern sv_button_t *button2;
extern sv_button_t *button3;

void step_flipled(act_t *gen_act)
{
    act_flipled_t *act = (act_flipled_t *) gen_act;
    
/*    switch(act->pc) {
        case 0:
            // while
            L0:
            if (!(true)) goto L1;
            sensitize((sv_t *)button0, &act->trig1);
            act->pc = 1;
            return;
        case 1:
            desensitize(&act->trig1);
            later_led(&led0, now + 4000000, true);
            sensitize((sv_t *)&led0, &act->trig1);
            act->pc = 2;
            return;
        case 2:
            desensitize(&act->trig1);
            later_led(&led0, now + 4000000, false);
            sensitize((sv_t *)&led0, &act->trig1);
            act->pc = 3;
            return;
        case 3:
            desensitize(&act->trig1);
            later_led(&led0, now + 4000000, true);
            sensitize((sv_t*)&led0, &act->trig1);
            act->pc = 4;
            return;
        case 4:
            desensitize(&act->trig1);
            later_led(&led0, now + 4000000, false);
            sensitize((sv_t*)&led0, &act->trig1);
            act->pc = 5;
            return;
        case 5:
            desensitize(&act->trig1);
            later_led(&led0, now + 4000000, true);
            sensitize((sv_t*)&led0, &act->trig1);
            act->pc = 6;
            return;
        case 6:
            desensitize(&act->trig1);
            later_led(&led0, now + 4000000, false);
            sensitize((sv_t*)&led0, &act->trig1);
            act->pc = 7;
            return;
        case 7:
            desensitize(&act->trig1);
            later_led(&led0, now + 4000000, true);
            sensitize((sv_t*)&led0, &act->trig1);
            act->pc = 8;
            return;
        case 8:
            desensitize(&act->trig1);
            later_led(&led0, now + 4000000, false);
            sensitize((sv_t*)&led0, &act->trig1);
            goto L0;
            L1:
        case 9:
        leave((act_t *) act, sizeof(act_flipled_t));
    }*/

    switch(act->pc) {
        case 0:
            // while
            L0:
            if (!(true)) goto L1;
            sensitize((sv_t *)button0, &act->trig1);
            sensitize((sv_t *)button1, &act->trig2);
            sensitize((sv_t *)button2, &act->trig3);
            sensitize((sv_t *)button3, &act->trig4);
            act->pc = 1;
            return;
        case 1:
            desensitize(&act->trig1);
            desensitize(&act->trig2);
            desensitize(&act->trig3);
            desensitize(&act->trig4);
            if(event_on((sv_t*)button0)) {
              assign_led(&led0, act->priority, led0.value ? false : true);
            }
            if(event_on((sv_t*)button1)) {
              assign_led(&led1, act->priority, led1.value ? false : true);
            }
            if(event_on((sv_t*)button2)) {
              assign_led(&led2, act->priority, led2.value ? false : true);
            }
            if(event_on((sv_t*)button3)) {
              assign_led(&led3, act->priority, led3.value ? false : true);
            }
            goto L0;
            L1:
        case 3:
        leave((act_t *) act, sizeof(act_flipled_t));
    }
}
```
