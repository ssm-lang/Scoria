## prj.conf
```kconfig
# CONFIG_BT=y
# CONFIG_BT_GATT_DYNAMIC_DB=y
# # CONFIG_BT_DEBUG_LOG=n
# CONFIG_BT_SMP=y
# CONFIG_BT_PERIPHERAL=y
# CONFIG_BT_DIS=y
# CONFIG_BT_DIS_PNP=y
# CONFIG_BT_DEVICE_NAME="Client"
# CONFIG_BT_CENTRAL=y
# CONFIG_BT_SMP=y

# CONFIG_BT_GATT_CLIENT=y
# CONFIG_BT_GATT_SERVICE_CHANGED=y
# CONFIG_BT_GATT_CACHING=y

# without this it does not link in the k_malloc code, it will just
# cryptically throw undefined reference k_malloc in your face. Including
# kernel.h where it is defined does nothing. With this thing, however, it
# is not even required to include kernel.h.
CONFIG_HEAP_MEM_POOL_SIZE=32768
# This flag is explained here: https://docs.zephyrproject.org/1.9.0/reference/kconfig/CONFIG_SYS_CLOCK_TICKS_PER_SEC.html#cmdoption-arg-config-sys-clock-ticks-per-sec
# CONFIG_SYS_CLOCK_TICKS_PER_SEC=1000
CONFIG_MINIMAL_LIBC_MALLOC_ARENA_SIZE=65536

CONFIG_RING_BUFFER=y

#CONFIG_ASSERT=y
#CONFIG_ASSERT_LEVEL=1

## CONFIG I2C
CONFIG_I2C=y

## CONFIG SPI
#CONFIG_SPI=y
#CONFIG_NRFX_SPIM1=y
#CONFIG_SPI_1=y

## Config BME280
#CONFIG_SENSOR=y
#CONFIG_BME280=y

## Message box
CONFIG_NUM_MBOX_ASYNC_MSGS=10

## Counters 
CONFIG_COUNTER=y
CONFIG_COUNTER_TIMER4=y
#CONFIG_HAS_STM32CUBE=y
#CONFIG_USE_STM32_HAL_TIM=y
## Power management
#CONFIG_PM=y
#CONFIG_SYS_POWER_MANAGEMENT=y
#CONFIG_PM_POLICY_APP=y
#CONFIG_MP_NUM_CPUS=1

## CONFIG USB CDC
CONFIG_STDOUT_CONSOLE=y
CONFIG_GPIO=y
CONFIG_USB=y
CONFIG_USB_DEVICE_STACK=y
CONFIG_USB_DEVICE_PRODUCT="Zephyr CDC ACM sample"
#CONFIG_USB_DRIVER_LOG_LEVEL_ERR=y
#CONFIG_USB_CDC_ACM=y
#CONFIG_USB_DEVICE_LOG_LEVEL_ERR=y
CONFIG_SERIAL=y
CONFIG_LOG=y
CONFIG_UART_INTERRUPT_DRIVEN=y
CONFIG_UART_LINE_CTRL=y
```

## stm32f4_discovery.overlay
```dts
/ {
     aliases {
          ssm-button0 = &user_button;
	  ssm-timer   = &timers3; /* not working */

	  ssm-led0    = &led0;
	  
     };
};

&timers3 {
	 status = "okay";
};
```

## src/main.c
```c
#include <zephyr/types.h>
#include <stddef.h>
#include <stdio.h>
#include <errno.h>
#include <zephyr.h>
#include <sys/printk.h>
#include <sys/byteorder.h>
#include <sys/ring_buffer.h>

#include <drivers/gpio.h>
#include <drivers/uart.h>
#include <drivers/i2c.h>
#include <drivers/sensor.h>
#include <drivers/counter.h>

#include "fib.h"
#include "blinky.h"

#include "usb_cdc.h"
#include "led.h"

//#define PRINT usb_printf
#define PRINT printk

/* ********** */
/*   TIMER    */

#define TIMER DT_LABEL(DT_ALIAS(ssm_timer))
/* Not sure how to do the similar thing on the STM32 yet. */


struct  counter_alarm_cfg alarm_cfg;

const struct device *counter_dev = NULL;

/* *************** */
/*   TOP           */

void top_return(act_t *act)
{
  return;
}

act_t top = { .step = top_return };

/* ************************************************************ */
/* hw_tick                                                      */
/* ************************************************************ */

#define MAX_MESSAGES  100
#define MSG_ALIGNMENT 1


K_MSGQ_DEFINE(tick_msgq, 1, MAX_MESSAGES,MSG_ALIGNMENT);

void hw_tick(const struct device *dev, uint8_t chan, uint32_t ticks, void *user_data) {

  /* Put a tick on the messagebox */
  uint8_t msg = 1;
  k_msgq_put(&tick_msgq, &msg, K_NO_WAIT);
  /* this can fail to send the message. then what? */
}


K_THREAD_STACK_DEFINE(tick_thread_stack, 512);
struct k_thread tick_thread;

sv_int_t r;

void tick_thread_main(void * a, void* b, void *c) {
  (void)a;
  (void)b;
  (void)c;

  //sv_int_t r;
  initialize_int(&r);
  r.value = 0;
  now = 0;
  sv_int_t led;
  initialize_int(&led);
  led.value = 0;

  uint8_t recv_msg;

  //PRINT("forking myfib\r\n");
  //fork_routine( (act_t *) enter_myfib(&top, PRIORITY_AT_ROOT, DEPTH_AT_ROOT, 4, &r) );

  PRINT("forking blinky\r\n");
  fork_routine( (act_t *) enter_main(&top, PRIORITY_AT_ROOT, DEPTH_AT_ROOT, &led) );

  PRINT("Waiting for ticks\r\n");
  int i = 0;
  while (1) {

    /* get a data item, waiting as long as needed */
    k_msgq_get(&tick_msgq, &recv_msg, K_FOREVER);

    uint32_t count;
    counter_get_value(counter_dev, &count);


    PRINT("*** *** *** *** *** ***\r\n");
    PRINT("ctr: %u\r\n", count);
    PRINT("now: %llu\r\n", now);
    PRINT("next: %llu\r\n", next_event_time());

    now = next_event_time();
    tick();

    uint64_t next = next_event_time();
    PRINT("next after tick: %llu\r\n", next);

    if (next == ULLONG_MAX) {
      /* This just means that there are no events in the queue (or a remarkable coincidence) */
      /* What to do in this case ?*/
      /*  - Go to sleep and await being woken from outside source */

      PRINT("NOTHING IN THE QUEUE\r\n");
    }

    uint64_t wake_time = next_event_time(); /* Absolute time */

    //PRINT("sleep_time = %lld\r\n", sleep_time);

    alarm_cfg.flags = COUNTER_ALARM_CFG_ABSOLUTE | COUNTER_ALARM_CFG_EXPIRE_WHEN_LATE;
    alarm_cfg.ticks = wake_time;

    int r = counter_set_channel_alarm(counter_dev, 0, &alarm_cfg);
    if (!r) {
      //PRINT("hw_tick: Alarm set\r\n");
    } else {
      if (r == - ENOTSUP ) {
	PRINT("hw_tick: Error setting alarm (ENOTSUP)\r\n");
      } else if ( r == - EINVAL ) {
	PRINT("hw_tick: Error setting alarm (EINVAL)\r\n");
      } else if ( r == - ETIME ) {
	PRINT("hw_tick: Error setting alarm (ETIME)\r\n");
      } else {
	PRINT("hw_tick: Error setting alarm\r\n");
      }
    }

    i++;
  }
}

void start_tick_thread(void) {

  k_thread_create(&tick_thread, tick_thread_stack,
		  K_THREAD_STACK_SIZEOF(tick_thread_stack),
		  tick_thread_main,
		  NULL, NULL, NULL,
		  5, 0, K_NO_WAIT);
}

/* ************************************************************ */
/* MAIN                                                         */
/* ************************************************************ */

void main(void) {

  /* *************  */
  /* Start USB_CDC  */
  //  start_usb_cdc_thread();

  //PRINT("USB_CDC: started\r\n");
  PRINT("Sleeping 1 seconds\r\n");
  k_sleep(K_SECONDS(1)); // Wait enough for starting up a terminal.
  PRINT("WOKE UP\r\n");

  PRINT("Init LEDs\r\n");
  led_driver_t *led0 = led_init(0);
  if (!led0) {
    PRINT("ERROR INIT LEDs\r\n");
    return;
  }

  PRINT("Init Blinky\r\n");
  init_blinky();

  /* ************************* */
  /* Hardware timer experiment */
  PRINT("Configuring hardware timer \r\n");
  counter_dev = device_get_binding(TIMER);
  if (!counter_dev) {
    PRINT("HWCounter: Device not found error\r\n");
  }

  if (counter_get_frequency(counter_dev) > 1000000) {
    PRINT("HWCounter: Running at %dMHz\r\n", counter_get_frequency(counter_dev) / 1000000);
  } else {
    PRINT("HWCounter: Running at %dHz\r\n", counter_get_frequency(counter_dev));
  }



  alarm_cfg.flags = COUNTER_ALARM_CFG_ABSOLUTE | COUNTER_ALARM_CFG_EXPIRE_WHEN_LATE;
  alarm_cfg.ticks = 10; //counter_us_to_ticks(counter_dev, 0);
  alarm_cfg.callback = hw_tick;
  alarm_cfg.user_data = &alarm_cfg;


  if (!counter_set_channel_alarm(counter_dev, 0, &alarm_cfg)) {
    PRINT("HWCounter: Alarm set\r\n");
  } else {
    PRINT("HWCounter: Error setting alarm\r\n");
  }
  if (!counter_set_guard_period(counter_dev, UINT_MAX/2, COUNTER_GUARD_PERIOD_LATE_TO_SET)) {
    PRINT("HWCounter: Guard period set\r\n");
  } else {
    PRINT("HWCounter: Error setting guard period\r\n");
  }

  counter_start(counter_dev);

  /* configure uart */

  PRINT("Starting Tick-Thread\r\n");
  start_tick_thread();

  int led0_state = 0;

  while(1) {
    led_set(led0,led0_state);
    led0_state = 1 - led0_state;
    k_sleep(K_SECONDS(4));
  }
}
```

## src/led.c
```c
/**********************************************************************************/
/* MIT License									  */
/* 										  */
/* Copyright (c) 2021 Joel Svensson, Abhiroop Sarkar 				  */
/* 										  */
/* Permission is hereby granted, free of charge, to any person obtaining a copy	  */
/* of this software and associated documentation files (the "Software"), to deal  */
/* in the Software without restriction, including without limitation the rights	  */
/* to use, copy, modify, merge, publish, distribute, sublicense, and/or sell	  */
/* copies of the Software, and to permit persons to whom the Software is	  */
/* furnished to do so, subject to the following conditions:			  */
/* 										  */
/* The above copyright notice and this permission notice shall be included in all */
/* copies or substantial portions of the Software.				  */
/* 										  */
/* THE SOFTWARE IS PROVIDED "AS IS", WITHOUT WARRANTY OF ANY KIND, EXPRESS OR	  */
/* IMPLIED, INCLUDING BUT NOT LIMITED TO THE WARRANTIES OF MERCHANTABILITY,	  */
/* FITNESS FOR A PARTICULAR PURPOSE AND NONINFRINGEMENT. IN NO EVENT SHALL THE	  */
/* AUTHORS OR COPYRIGHT HOLDERS BE LIABLE FOR ANY CLAIM, DAMAGES OR OTHER	  */
/* LIABILITY, WHETHER IN AN ACTION OF CONTRACT, TORT OR OTHERWISE, ARISING FROM,  */
/* OUT OF OR IN CONNECTION WITH THE SOFTWARE OR THE USE OR OTHER DEALINGS IN THE  */
/* SOFTWARE.									  */
/**********************************************************************************/

#include "led.h"

#include <drivers/gpio.h>

#define LED_DEVICE_LABEL(X) DT_GPIO_LABEL(DT_ALIAS(X), gpios)
#define LED_PIN(X)          DT_GPIO_PIN(DT_ALIAS(X), gpios)
#define LED_FLAGS(X)        DT_GPIO_FLAGS(DT_ALIAS(X), gpios)

#define CONFIG_LED_CASE(X) \
  case X: \
  led_drivers[(X)].pin = LED_PIN(led##X);	\
  led_drivers[(X)].id  = (X); \
  led_drivers[(X)].state = false; \
  gpio_pin_configure(led_device, led_drivers[(X)].pin, GPIO_OUTPUT_ACTIVE | LED_FLAGS(led##X)); \
  gpio_pin_set(led_device, led_drivers[(X)].pin, 0); \
  break;

led_driver_t led_drivers[10];
const struct device *led_device;

uint32_t led_num(void) {
  uint32_t num_leds = 0;

#if DT_NODE_HAS_STATUS(DT_ALIAS(led0), okay)
  num_leds = num_leds + 1;
#endif
#if DT_NODE_HAS_STATUS(DT_ALIAS(led1), okay)
  num_leds = num_leds + 1;
#endif
#if DT_NODE_HAS_STATUS(DT_ALIAS(led2), okay)
  num_leds = num_leds + 1;
#endif
#if DT_NODE_HAS_STATUS(DT_ALIAS(led3), okay)
  num_leds = num_leds + 1;
#endif
#if DT_NODE_HAS_STATUS(DT_ALIAS(led4), okay)
   num_leds = num_leds + 1;
#endif
#if DT_NODE_HAS_STATUS(DT_ALIAS(led5), okay)
   num_leds = num_leds + 1;
#endif
#if DT_NODE_HAS_STATUS(DT_ALIAS(led6), okay)
   num_leds = num_leds + 1;
#endif
#if DT_NODE_HAS_STATUS(DT_ALIAS(led7), okay)
   num_leds = num_leds + 1;
#endif
#if DT_NODE_HAS_STATUS(DT_ALIAS(led8), okay)
   num_leds = num_leds + 1;
#endif
#if DT_NODE_HAS_STATUS(DT_ALIAS(led9), okay)
   num_leds = num_leds + 1;
#endif
  return num_leds;
}

uint32_t led_identifiers(void) {
  uint32_t id_mask = 0;
#if DT_NODE_HAS_STATUS(DT_ALIAS(led0), okay)
  id_mask = id_mask | (1 << 0);
#endif
#if DT_NODE_HAS_STATUS(DT_ALIAS(led1), okay)
  id_mask = id_mask | (1 << 1);
#endif
#if DT_NODE_HAS_STATUS(DT_ALIAS(led2), okay)
  id_mask = id_mask | (1 << 2);
#endif
#if DT_NODE_HAS_STATUS(DT_ALIAS(led3), okay)
  id_mask = id_mask | (1 << 3);
#endif
#if DT_NODE_HAS_STATUS(DT_ALIAS(led4), okay)
  id_mask = id_mask | (1 << 4);
#endif
#if DT_NODE_HAS_STATUS(DT_ALIAS(led5), okay)
  id_mask = id_mask | (1 << 5);
#endif
#if DT_NODE_HAS_STATUS(DT_ALIAS(led6), okay)
  id_mask = id_mask | (1 << 6);
#endif
#if DT_NODE_HAS_STATUS(DT_ALIAS(led7), okay)
  id_mask = id_mask | (1 << 7);
#endif
#if DT_NODE_HAS_STATUS(DT_ALIAS(led8), okay)
  id_mask = id_mask | (1 << 8);
#endif
#if DT_NODE_HAS_STATUS(DT_ALIAS(led9), okay)
  id_mask = id_mask | (1 << 9);
#endif
   return id_mask;
}

led_driver_t* led_init(uint32_t identifier) {

  if (!led_device) {
    /* assumption all leds will have the same device label */
    led_device = device_get_binding(LED_DEVICE_LABEL(led0));
  }

  if (!led_device) return false;

  switch(identifier) {
#if DT_NODE_HAS_STATUS(DT_ALIAS(led0), okay)
  CONFIG_LED_CASE(0);
#endif
#if DT_NODE_HAS_STATUS(DT_ALIAS(led1), okay)
  CONFIG_LED_CASE(1);
#endif
#if DT_NODE_HAS_STATUS(DT_ALIAS(led2), okay)
  CONFIG_LED_CASE(2);
#endif
#if DT_NODE_HAS_STATUS(DT_ALIAS(led3), okay)
  CONFIG_LED_CASE(3);
#endif
#if DT_NODE_HAS_STATUS(DT_ALIAS(led4), okay)
  CONFIG_LED_CASE(4);
#endif
#if DT_NODE_HAS_STATUS(DT_ALIAS(led5), okay)
  CONFIG_LED_CASE(5);
#endif
#if DT_NODE_HAS_STATUS(DT_ALIAS(led6), okay)
  CONFIG_LED_CASE(6);
#endif
#if DT_NODE_HAS_STATUS(DT_ALIAS(led7), okay)
  CONFIG_LED_CASE(7);
#endif
#if DT_NODE_HAS_STATUS(DT_ALIAS(led8), okay)
  CONFIG_LED_CASE(8);
#endif
#if DT_NODE_HAS_STATUS(DT_ALIAS(led9), okay)
  CONFIG_LED_CASE(9);
#endif
  default:
    return NULL;
  }
  return &led_drivers[identifier];
}

void led_set(led_driver_t *led, bool value) {

  if (led) {
    led->state = value;
    gpio_pin_set(led_device, led->pin, led->state);
  }
}
```
